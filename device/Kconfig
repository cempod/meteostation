## device/Kconfig
```kconfig
#
# For a description of the syntax of this configuration file,
# see the file kconfig-language.txt in the NuttX tools repository.
#

config ARCH_BOARD_METEOSTATION
    bool "meteostation board"
    depends on ARCH_CHIP_STM32H743VI
    select ARCH_HAVE_LEDS
    select ARCH_HAVE_BUTTONS
    select ARCH_HAVE_IRQBUTTONS

config METEO_LEDS
    bool "Enable meteo leds"
    default y
    ---help---
        This enables meteo leds driver.

if ARCH_BOARD_METEOSTATION

endif # ARCH_BOARD_METEOSTATION
```

## src/modules/led_controller/Kconfig
```kconfig
#
# For a description of the syntax of this configuration file,
# see the file kconfig-language.txt in the NuttX tools repository.
#

config MODULES_LED_CONTROLLER
	tristate "Led controller"
	default n
	---help---
		Enable the led controller

if MODULES_LED_CONTROLLER

config MODULES_LED_CONTROLLER_PROGNAME
	string "Program name"
	default "led_controller"
	---help---
		This is the name of the program that will be used when the NSH ELF
		program is installed.

config MODULES_LED_CONTROLLER_PRIORITY
	int "Led controller task priority"
	default 100

config MODULES_LED_CONTROLLER_STACKSIZE
	int "Led controller stack size"
	default DEFAULT_TASK_STACKSIZE

endif 
```
